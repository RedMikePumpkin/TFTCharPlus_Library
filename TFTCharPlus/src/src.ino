#include <Esplora.h>
#include <SPI.h>
#include <TFT.h>

TFT myTFT = EsploraTFT;

uint8_t libTextSize = 1;
TFT tft = TFT(0, 0, 0);

void setup() {
  myTFT.begin();
  myTFT.background(0, 0, 0);
  setUsedTFT(myTFT);
  setCharColor(255, 255, 255);
  setCharSize(5);
  drawChar(0xf8, 0xa8, 0x50, 0x0d, 0x0b, 0, 0);
}

void loop() {
  // WE AINT NEEDIN' 'DIS!
}

void changeUsedTFT(TFT newTFT) {
  tft = newTFT;
}

void setCharColor(uint8_t r, uint8_t g, uint8_t b) {
  tft.stroke(r, g, b);
  tft.fill(r, g, b);
}

void setCharSize(uint8_t size) {
  textSize = size;
}

void drawChar(byte data1, byte data2, byte data3, byte data4, byte data5, uint8_t xpos, uint8_t ypos) {
  byte data[5] = {data1, data2, data3, data4, data5};
  for (uint8_t x = 0; x < 5; x++) {
    for (uint8_t y = 0; y < 8; y++) {
      if (bitRead(data[x], 7 - y)) {
        tft.rect(x*textSize+xpos, y*textSize+ypos, textSize, textSize);
      }
    }
  }
}